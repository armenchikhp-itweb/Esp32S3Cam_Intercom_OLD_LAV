## main/Kconfig.projbuild
```kconfig
menu "Project Configuration"

    config WIFI_SSID
        string "WiFi SSID"
        default "My_Home_WiFi"
        help
            Имя твоей Wi-Fi сети.

    config WIFI_PASSWORD
        string "WiFi Password"
        default "password123"
        help
            Пароль от Wi-Fi.

    config GEMINI_API_KEY
        string "Gemini API Key"
        default "your_api_key_here"
        help
            Твой ключ от Google AI Studio.

    config AUDIO_SAMPLE_RATE
        int "Audio Sample Rate"
        default 16000
        help
            Частота дискретизации (16000 или 44100).

    menu "Hardware Pins"
        config MIC_DIN_GPIO
            int "Microphone DIN GPIO"
            default 42
        config SPK_DOUT_GPIO
            int "Speaker DOUT GPIO"
            default 39
        # Можно добавить и остальные пины здесь
    endmenu

endmenu
```

## sdkconfig.defaults
```kconfig
# Flash Settings
CONFIG_ESPTOOLPY_FLASHMODE_OPI=y
CONFIG_ESPTOOLPY_FLASHSIZE_16MB=y
CONFIG_ESPTOOLPY_FLASHFREQ_80M=y

# PSRAM (N16R8 Specific)
CONFIG_SPIRAM=y
CONFIG_SPIRAM_MODE_OCT=y
# CONFIG_SPIRAM_TYPE_ESP32S3_N16R8=y
CONFIG_ESP32S3_SPIRAM_SUPPORT=y
CONFIG_SPIRAM_SPEED_80M=y
# CONFIG_SPIRAM_FETCH_CONTROL_BLOCK_SIZE=64
CONFIG_SPIRAM_RODATA=y

# Partition Table
CONFIG_PARTITION_TABLE_CUSTOM=y
CONFIG_PARTITION_TABLE_CUSTOM_FILENAME="partitions.csv"
```
